// CPC ID: cim-b1
// Parent ID: cim-a1sr-c
// Name: Face Monitor Component
// Description: 

#include <WiFiNINA.h>
#include <PubSubClient.h>
#include <FreeRTOS_SAMD21.h>
#include <task.h>
#include "secrets.h"
#include "comm_utils.h"
#include <Arduino_JSON.h>
#include <ArduinoJson.h>

// Global variables for WiFi and MQTT connectivity
const char* eventoDeIdentificación_MessageSenderClientId = "faceMonitorComponentClient_cim_b1";
WiFiClient eventoDeIdentificación_MessageSenderClient;
PubSubClient eventoDeIdentificación_MessageSenderMqttClient(eventoDeIdentificación_MessageSenderClient);

bool debug = true;

// MQTT topics for this CPC ({CPS_id}/{CPC_id}/{comm_thread_id})

// Comm Topics(Sender)
const char* eventoDeIdentificación_MessageSender_topic = "svif_sdSvif_sr_sd_DependenciasEstrategicasSr_VistaHibridaSd_sr/cim_b1/cim_d1_comm_thread/dependum";

// Thread Status variables
bool monitorearPresenciaDePersonas_GoalAchieved = false; // Global variable for thread monitorearPresenciaDePersonas(ID: cim-g1)
TaskHandle_t TaskmonitorearPresenciaDePersonas;

// Function output variables
uint8_t* capturarImagen_frame; // Cuadro capturado por la camara.
uint8_t* detectarRostro_face; // Region de rostro detectada.
IdentificationEvent identificarRostro_identification_event; // Evento de identificacion resultante.
bool compararConRostrosEnrolados_match = false; // Coincidencia con la base de enrolados.

// Global Operation Mode Variables


// Global Data Structures (software resources and/or any dependum)
struct eventoDeIdentificación_MessageSender_data_structure {
    unsigned long timestamp; // Marca de tiempo del evento.
    char[32] person_id; // Identificador de la persona.
    char[32] person_name; // Nombre de la persona.
    float confidence; // Confianza de la identificacion.
    bool authorized; // Indicador de autorizacion.
} eventoDeIdentificación_MessageSender_data_structure;

struct baseDeRostrosEnrolados_data_structure {
    char[32] person_id; // Identificador del enrolado.
    char[32] person_name; // Nombre del enrolado.
    char[64] face_template; // Plantilla biometrica local.
} baseDeRostrosEnrolados_data_structure;


// Comm Thread Handles
TaskHandle_t TaskpublishDependum_eventoDeIdentificación_MessageSender;

void setup() {
    if (debug) {
        Serial.begin(9600);
        while (!Serial);
    }
    connectToWiFi();

    // Connection and subscription to topics(Sender)
    mqttSetup(eventoDeIdentificación_MessageSenderMqttClient);
    connectToMQTT(eventoDeIdentificación_MessageSenderMqttClient, eventoDeIdentificación_MessageSenderClientId, eventoDeIdentificación_MessageSender_topic);
    
    // Create tasks for the operational goals
    xTaskCreate(
        monitorearPresenciaDePersonasTask,        // Function to implement the task
        "monitorearPresenciaDePersonasTask",      // Name of the task
        512,                      // Stack size (in words, not bytes)
        NULL,                     // Task input parameter
        1,                        // Priority of the task
        &TaskmonitorearPresenciaDePersonas        // Task handle
    );
    xTaskCreate(
        publishDependum_eventoDeIdentificación_MessageSenderTask,        // Function to implement the task
        "publishDependum_eventoDeIdentificación_MessageSenderTask",      // Name of the task
        512,                      // Stack size (in words, not bytes)
        NULL,                     // Task input parameter
        1,                        // Priority of the task
        &TaskpublishDependum_eventoDeIdentificación_MessageSender        // Task handle
    );

    // Start the threads
    vTaskStartScheduler();
}



void publishDependum_eventoDeIdentificación_MessageSenderTask(void *pvParameters) {

    //
    // --- Comm Thread Information ---
    // Name: Evento de identificación - message sender
    // ID: cim-d1-comm_thread
    // Description: This Comm Thread is responsible for generating the dependum: eventoDeIdentificación_MessageSender_data_structure
    //
    // Original Element in PIM: Evento de identificación - message sender
    // Transformed To: Function `eventoDeIdentificación_MessageSender()`
    //
    // Note for Developers:
    // The `dependum` data should be generated by the function publicarEventoDeIdentificación().
    // Ensure the function completes its operation and provides the required data 
    // in the appropriate format for transmission.
    // 
    // Qualification Array:
    //  * None specified.
    // 
    // Contribution Array:
    //  * None specified.
    // 
    //
    // This variable handles the period in milliseconds for thread execution
    const TickType_t xDelay = pdMS_TO_TICKS(500);
    for (;;) {
        // Create a JSON object for the dependum
        JSONVar dependumJson;
        dependumJson["timestamp"] = eventoDeIdentificación_MessageSender_data_structure.timestamp;
        dependumJson["person_id"] = eventoDeIdentificación_MessageSender_data_structure.person_id;
        dependumJson["person_name"] = eventoDeIdentificación_MessageSender_data_structure.person_name;
        dependumJson["confidence"] = eventoDeIdentificación_MessageSender_data_structure.confidence;
        dependumJson["authorized"] = eventoDeIdentificación_MessageSender_data_structure.authorized;

        // Convert the JSON object to a string
        String dependumMessage = JSON.stringify(dependumJson);



        eventoDeIdentificación_MessageSenderMqttClient.publish(eventoDeIdentificación_MessageSender_topic, dependumMessage.c_str());  // Publish message
        if (debug) {
            Serial.println("Dependum published successfully for Evento de identificación - message sender!");
            Serial.print("Topic: ");
            Serial.println(eventoDeIdentificación_MessageSender_topic);
            Serial.print("Message: ");
            Serial.println(dependumMessage);
        } else {
            if (debug) {
                Serial.println("Failed to publish dependum for Evento de identificación - message sender.");
            }
            
        }
        vTaskDelay(xDelay);
    }
}




void loop() {

    // Let FreeRTOS manage tasks, nothing to do here
    delay(100);
}

bool capturarImagen() {
    // Function ID: cim-t1
    // Parent ID: cim-t1
    // Input Parameters:
    // Output Parameters:
        // frame(uint8_t*) - Cuadro capturado por la camara.
    // Qualification Array:
    //  * None specified.
    // Contribution Array:
    //  * None specified.
    // Hardware Resource Assigned:
    // Set output parameters
 

    // --- Your code goes here ---
    
    
    
    return true;

    // --- Your code goes here ---
}

bool detectarRostro(uint8_t* frame) {
    // Function ID: cim-t2
    // Parent ID: cim-t2
    // Input Parameters:
        // frame(uint8_t*) - Cuadro capturado por la camara.
    // Output Parameters:
        // face(uint8_t*) - Region de rostro detectada.
    // Qualification Array:
    //  * None specified.
    // Contribution Array:
    //  * None specified.
    // Hardware Resource Assigned:
    // Set output parameters
 

    // --- Your code goes here ---
    
    
    
    return true;

    // --- Your code goes here ---
}

bool identificarRostro(uint8_t* frame) {
    // Function ID: cim-t3
    // Parent ID: cim-t3
    // Input Parameters:
        // frame(uint8_t*) - Cuadro capturado por la camara.
    // Output Parameters:
        // identification_event(IdentificationEvent) - Evento de identificacion resultante.
    // Qualification Array:
    //  * None specified.
    // Contribution Array:
    //  * None specified.
    // Hardware Resource Assigned:
    // Set output parameters
 

    // --- Your code goes here ---
    
    
    
    return true;

    // --- Your code goes here ---
}

bool publicarEventoDeIdentificación(IdentificationEvent identification_event) {
    // Function ID: cim-t5
    // Parent ID: cim-t5
    // Input Parameters:
        // identification_event(IdentificationEvent) - Evento de identificacion a publicar.
    // Output Parameters:
    // Qualification Array:
    //  * None specified.
    // Contribution Array:
    //  * - "[{ "softgoal_id": "cim-q2", "name": "Privacidad de datos personales", "contribution": "hurt"}]"
    // Hardware Resource Assigned:
    // Set output parameters
 

    // --- Your code goes here ---
    
    
    
    return true;

    // --- Your code goes here ---
}

bool compararConRostrosEnrolados(uint8_t* face) {
    // Function ID: cim-t4
    // Parent ID: cim-t4
    // Input Parameters:
        // face(uint8_t*) - Region de rostro detectada.
    // Output Parameters:
        // match(bool) - Coincidencia con la base de enrolados.
    // Qualification Array:
    //  * None specified.
    // Contribution Array:
    //  * - "[{ "softgoal_id": "cim-q2", "name": "Privacidad de datos personales", "contribution": "help"}]"
    // Hardware Resource Assigned:
    // Set output parameters
    compararConRostrosEnrolados_match = false; // Coincidencia con la base de enrolados.


    // --- Your code goes here ---
    
    
    
    return true;

    // --- Your code goes here ---
}

// Task for monitorearPresenciaDePersonas
void monitorearPresenciaDePersonasTask(void *pvParameters) {
    // This variable handles the period in milliseconds for thread execution
    const TickType_t xDelay = pdMS_TO_TICKS(500); // Example interval for monitorearPresenciaDePersonas

    // --- monitorearPresenciaDePersonas Context Information ---
    // ID: cim-g1
    // ID CIM Parent: cim-g1
    // qualification_array: 
    //  * - "[{ "softgoal_id": "cim-q1", "name": "Identificación oportuna"}]"
    // contribution_array: 
    //  * None specified.
    // ----------------------------------------------------------

    for (;;) {
        // --- Your code goes here ---
        // Evaluate the state of monitorearPresenciaDePersonas

        monitorearPresenciaDePersonas_GoalAchieved = !monitorearPresenciaDePersonas_GoalAchieved; // Toggle state for simulation
        
        // --- Your code ends here ---

        vTaskDelay(xDelay);
    }
}
